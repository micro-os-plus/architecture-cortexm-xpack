# Generic_ARMv8MBaseline register map
Vendor: ARM Ltd.; Series: ARMv8-M Baseline architecture (Cortex-M23); File version: 1.0
Generic ARMv8-M Baseline system-peripheral template: NVIC, SCB, SysTick, DCB (named CoreDebug prior to CMSIS_6), and an optional MPU -- plus the optional Security Extension (TrustZone) SAU peripheral and the Secure/Non-secure fields on NVIC/SCB/DCB. No SCnSCB on this profile (Baseline's own core_cm23.h defines none, same as ARMv6-M). Built from CMSIS_6's core_cm23.h (Cortex-M23's core header), NOT from any single vendor SVD. IMPORTANT: __VTOR_PRESENT, __MPU_PRESENT, __SAUREGION_PRESENT, whether the Security Extension is implemented at all, and __NVIC_PRIO_BITS are all implementation-defined per ARMv8-M Baseline device -- see the individual peripheral descriptions and the <cpu> block below. Field widths for priority registers (NVIC IPRn, SCB SHPR2/SHPR3) are kept at their full architectural 8 bits rather than narrowed to a specific device's __NVIC_PRIO_BITS. Baseline keeps ARMv6-M's minimal fault model (no MemManage/BusFault/UsageFault/SecureFault/Debug-Monitor handlers, so no SHPR1/CFSR/HFSR/DFSR/NSACR/CPACR/SFSR/SFAR/ID_* registers either) but, unlike ARMv6-M, SHCSR is normally accessible from application code, not DAP-only. Verified against ARM-software/CMSIS_6@main commit 26206e47dc (2026-09-11), CMSIS-Core(M) v6.3.1-dev.
CPU: CM23 r0p0, little endian, no MPU, no FPU, 2 interrupt priority bits
Registers are 32-bit, read-write, reset 0x0 unless marked. A register's access mark holds for its fields unless they carry their own. Offsets are from the block's base; lines under a group give offsets from that group; [hi:lo] are bit positions; {n}, {i} and the like mark numbered series; 'fields as' and 'values as' point back to an identical list; <NAME> marks a mode.

## Memory map
0xE000E010 SysTick size 0x10 — SysTick Timer. Identical register set on every Cortex-M core (ARMv6-M through current ARMv8-M).
0xE000E100 NVIC size 0x4F0 — Nested Vectored Interrupt Controller. ARMv8-M packs interrupt state into 16 banks of 32 bits each (ISER/ICER/ISPR/ICPR/IABR/ITNS) plus 124 32-bit IPR words, covering the full architectural maximum of 496 external interrupts (verified against CMSIS_6 core_cm23.h/core_cm33.h: IPR is a 496-byte array, i.e. 124 words of 4 packed 8-bit priorities each -- same total on both profiles). ITNS (Interrupt Target Non-Secure) is new versus ARMv6-M/ARMv7-M: one bit per interrupt selecting whether it targets the Secure or the Non-secure state; Secure-only access, and RAZ/WI when the Security Extension is not implemented. No STIR on Baseline, matching ARMv6-M (STIR is Mainline-only across the whole Cortex-M family).
0xE000ED00 SCB size 0x28 — System Control Block, ARMv8-M Baseline register set. Verified against CMSIS_6 core_cm23.h. Minimal fault model like ARMv6-M -- no SHPR1, no CFSR/HFSR/MMFAR/BFAR/AFSR/CPACR/NSACR/SFSR/SFAR/ID_* registers at all (no MemManage/BusFault/UsageFault/SecureFault handlers on Baseline), no AIRCR.PRIGROUP (fixed priority split, like ARMv6-M). Unlike ARMv6-M, ICSR.RETTOBASE exists and SHCSR is normally accessible from application code, not DAP-only. Gains the Security Extension fields (ICSR.STTNS, AIRCR.SYSRESETREQS/BFHFNMINS/PRIS, SCR.SLEEPDEEPS, SHCSR.HARDFAULT*/NMIACT) -- Secure-only/RAZ-WI when the Security Extension is not implemented. CCR.STKALIGN and CCR.NONBASETHRDENA no longer exist as configurable bits, see the CCR register below.
0xE000ED90 MPU size 0x38 — Memory Protection Unit -- OPTIONAL on ARMv8-M Baseline (__MPU_PRESENT). Region format changed from ARMv7-M's RBAR/RASR (base + size-encoded) to RBAR/RLAR (base + limit), and gained MAIR0/MAIR1 memory-attribute indirection registers (verified against CMSIS_6 core_cm23.h/core_cm33.h). No alias registers on Baseline, matching ARMv6-M's MPU shape.
0xE000EDD0 SAU size 0x14 — Security Attribution Unit -- present only when the Security Extension (TrustZone) is implemented; absent entirely on a Non-secure-only/single-state part. RNR/RBAR/RLAR are further optional within that: only present when __SAUREGION_PRESENT=1, i.e. the implementation has at least one programmable SAU region (a part can implement the Security Extension with the whole memory map fixed Secure/Non-secure by IDAU alone and no SAU regions at all). Verified against CMSIS_6 core_cm23.h/core_cm33.h (identical on both profiles). SFSR/SFAR are modeled once, under SCB, since SAU_Type and SCB_Type both expose the same physical registers at the same address on Mainline -- CMSIS_6 now says so explicitly (SAU_Type's own SFSR/SFAR are commented "deprecated: use SCB->SFSR"/"SCB->SFAR"); Baseline has neither (no SecureFault handler exists there).
0xE000EDF0 DCB size 0x1C — Debug Control Block -- CMSIS's ARMv8-M name for what core_cm0.h/core_cm3.h call CoreDebug (same base address, 0xE000EDF0). Adds DAUTHCTRL (Debug Authentication Control) and DSCSR (Debug Security Control and Status) versus ARMv6-M/ARMv7-M's CoreDebug -- both Security-Extension-related, present regardless of profile. Verified against CMSIS_6 core_cm23.h/core_cm33.h. Baseline's DHCSR has no C_SNAPSTALL bit, and DEMCR only defines TRCENA/VC_CORERESET/VC_HARDERR -- no other VC_*, no MON_*, no MONPRKEY/UMON_EN/SDME/VC_SFERR -- matching Baseline's minimal exception model.

## Licence text in the file
ARM Limited (ARM) is supplying this software for use with Cortex-M processor based microcontroller, but can be equally used for other suitable processor architectures. This file can be freely distributed. Modifications to this file shall be clearly marked. . THIS SOFTWARE IS PROVIDED "AS IS". NO WARRANTIES, WHETHER EXPRESS, IMPLIED. OR STATUTORY, INCLUDING, BUT NOT LIMITED TO, IMPLIED WARRANTIES OF. MERCHANTABILITY AND FITNESS FOR A PARTICULAR PURPOSE APPLY TO THIS SOFTWARE. ARM SHALL NOT, IN ANY CIRCUMSTANCES, BE LIABLE FOR SPECIAL, INCIDENTAL, OR. CONSEQUENTIAL DAMAGES, FOR ANY REASON WHATSOEVER.
