# Generic_ARMv8MMainline register map
Vendor: ARM Ltd.; Series: ARMv8-M Mainline architecture (Cortex-M33 / Cortex-M35P / Cortex-M55 / Cortex-M85); File version: 1.0
Generic ARMv8-M Mainline system-peripheral template: NVIC (sized to the full architectural 496-interrupt maximum), SCB (the full ARMv7-M fault-handling set plus the Security Extension additions), SCnSCB (ICTR/ACTLR/CPPWR), SysTick, DCB (named CoreDebug prior to CMSIS_6), and an optional MPU with RBAR/RLAR base+limit regions -- plus the optional Security Extension (TrustZone) SAU peripheral. Built from CMSIS_6's core_cm33.h (Cortex-M33's core header), NOT from any single vendor SVD. The Security Extension itself, SAU region count, MPU presence, and FPU/DSP presence are all implementation-defined per device -- fields like NVIC.ITNS, SCB.NSACR/SFSR/SFAR, and the STTNS/SYSRESETREQS/BFHFNMINS/PRIS/SLEEPDEEPS/SECUREFAULT* bits are Secure-only and RAZ/WI (or fixed) when the Security Extension is absent. Deliberately excluded, same rationale as the ARMv7-M file: the FPU/MVFR/cache-maintenance register blocks (CLIDR/CTR/CCSIDR/CSSELR, ICIALLU..BPIALL, CCR.DC/IC/BP -- Cortex-M55/M85-specific cache support) and trace components (ITM/DWT/TPIU). Verified against ARM-software/CMSIS_6@main commit 26206e47dc (2026-09-11), CMSIS-Core(M) v6.3.1-dev.
CPU: CM33 r0p0, little endian, no MPU, no FPU, VTOR, 3 interrupt priority bits
Registers are 32-bit, read-write, reset 0x0 unless marked. A register's access mark holds for its fields unless they carry their own. Offsets are from the block's base; lines under a group give offsets from that group; [hi:lo] are bit positions; {n}, {i} and the like mark numbered series; 'fields as' and 'values as' point back to an identical list; <NAME> marks a mode.

## Memory map
0xE000E000 SCnSCB size 0x10 — System Control and ID Registers not in the SCB address range: ICTR (Interrupt Controller Type Register), ACTLR (Auxiliary Control Register), and CPPWR (Coprocessor Power Control -- new in ARMv8-M Mainline). Verified against CMSIS_6 core_cm33.h. Absent entirely on ARMv8-M Baseline, same as ARMv6-M.
0xE000E010 SysTick size 0x10 — SysTick Timer. Identical register set on every Cortex-M core (ARMv6-M through current ARMv8-M).
0xE000E100 NVIC size 0xE04 — Nested Vectored Interrupt Controller. ARMv8-M packs interrupt state into 16 banks of 32 bits each (ISER/ICER/ISPR/ICPR/IABR/ITNS) plus 124 32-bit IPR words, covering the full architectural maximum of 496 external interrupts (verified against CMSIS_6 core_cm23.h/core_cm33.h: IPR is a 496-byte array, i.e. 124 words of 4 packed 8-bit priorities each -- same total on both profiles). ITNS (Interrupt Target Non-Secure) is new versus ARMv6-M/ARMv7-M: one bit per interrupt selecting whether it targets the Secure or the Non-secure state; Secure-only access, and RAZ/WI when the Security Extension is not implemented. Mainline additionally has STIR, at the same offset as on ARMv7-M.
0xE000ED00 SCB blocks up to offset 0xEC — System Control Block, ARMv8-M Mainline register set. Verified against CMSIS_6 core_cm33.h. Superset of ARMv7-M's SCB plus the Security Extension: NSACR (Non-secure Access Control), SFSR/SFAR (Secure Fault Status/Address -- physically the same registers CMSIS also exposes via SAU->SFSR/SFAR; modeled once here, under SCB, since SAU and SCB share the same 0xE000ED00-0xE000EDEF page -- see the two <addressBlock> entries below and the SAU peripheral's description), and extra ICSR/AIRCR/SCR/SHCSR/CFSR bits (see the individual register descriptions). ID_ISAR now has 6 words (ID_ISAR5 added) versus 5 on ARMv7-M; the ID_* register names themselves also changed (ADR/DFR -> ID_AFR/ID_DFR) to match current CMSIS naming for ARMv8-M. Deliberately excluded, same rationale as ARMv7-M: CFSR.MLSPERR/LSPERR (FPU lazy-stacking bits) are documented but the FPU block itself is not modeled, and the cache-maintenance registers present on cache-capable implementations (CLIDR/CTR/CCSIDR/CSSELR, ICIALLU..BPIALL, MVFR0-2, CCR.DC/IC/BP -- Cortex-M55/M85-specific) are out of scope, same as trace components (ITM/DWT/TPIU).
0xE000ED90 MPU size 0x38 — Memory Protection Unit -- OPTIONAL on ARMv8-M Mainline (__MPU_PRESENT). Region format changed from ARMv7-M's RBAR/RASR (base + size-encoded) to RBAR/RLAR (base + limit), and gained MAIR0/MAIR1 memory-attribute indirection registers (verified against CMSIS_6 core_cm23.h/core_cm33.h). Includes 3 alias RBAR/RLAR pairs, same as ARMv7-M (MPU_TYPE_RALIASES=4). RLAR.PXN (Privileged eXecute Never, bit 4) is Mainline-only -- absent from Baseline's RLAR entirely, not just RAZ/WI.
0xE000EDD0 SAU size 0x14 — Security Attribution Unit -- present only when the Security Extension (TrustZone) is implemented; absent entirely on a Non-secure-only/single-state part. RNR/RBAR/RLAR are further optional within that: only present when __SAUREGION_PRESENT=1, i.e. the implementation has at least one programmable SAU region (a part can implement the Security Extension with the whole memory map fixed Secure/Non-secure by IDAU alone and no SAU regions at all). Verified against CMSIS_6 core_cm23.h/core_cm33.h (identical on both profiles). SFSR/SFAR are modeled once, under SCB, since SAU_Type and SCB_Type both expose the same physical registers at the same address on Mainline -- CMSIS_6 now says so explicitly (SAU_Type's own SFSR/SFAR are commented "deprecated: use SCB->SFSR"/"SCB->SFAR"); Baseline has neither (no SecureFault handler exists there).
0xE000EDF0 DCB size 0x1C — Debug Control Block -- CMSIS's ARMv8-M name for what core_cm0.h/core_cm3.h call CoreDebug (same base address, 0xE000EDF0). Adds DAUTHCTRL (Debug Authentication Control) and DSCSR (Debug Security Control and Status) versus ARMv6-M/ARMv7-M's CoreDebug -- both Security-Extension-related, present regardless of profile. Verified against CMSIS_6 core_cm23.h/core_cm33.h.

## Licence text in the file
ARM Limited (ARM) is supplying this software for use with Cortex-M processor based microcontroller, but can be equally used for other suitable processor architectures. This file can be freely distributed. Modifications to this file shall be clearly marked. . THIS SOFTWARE IS PROVIDED "AS IS". NO WARRANTIES, WHETHER EXPRESS, IMPLIED. OR STATUTORY, INCLUDING, BUT NOT LIMITED TO, IMPLIED WARRANTIES OF. MERCHANTABILITY AND FITNESS FOR A PARTICULAR PURPOSE APPLY TO THIS SOFTWARE. ARM SHALL NOT, IN ANY CIRCUMSTANCES, BE LIABLE FOR SPECIAL, INCIDENTAL, OR. CONSEQUENTIAL DAMAGES, FOR ANY REASON WHATSOEVER.
