# Generic_ARMv6M register map
Vendor: ARM Ltd.; Series: ARMv6-M architecture (Cortex-M0 / Cortex-M0+ / Cortex-M1 / SC000); File version: 1.0
Generic ARMv6-M system-peripheral template: NVIC, SCB, SysTick, DCB (named CoreDebug prior to CMSIS_6), and an optional MPU. Built from the verified union of what CMSIS_6's core_cm0.h and core_cm0plus.h declare for the architecture, NOT from any single vendor SVD (none of ST/Nordic/NXP's published SVDs define these). IMPORTANT: __VTOR_PRESENT, __MPU_PRESENT and __NVIC_PRIO_BITS are implementation-defined per ARMv6-M -- see the VTOR and MPU peripheral descriptions and the <cpu> block below for what varies by device. Field widths for priority registers (NVIC IPRn, SCB SHPR2/SHPR3) are kept at their full architectural 8 bits rather than narrowed to a specific device's __NVIC_PRIO_BITS, since that value differs per implementation (commonly 2, but the architecture permits others). Verified against ARM-software/CMSIS_6@main commit 26206e47dc (2026-09-11), CMSIS-Core(M) v6.3.1-dev.
CPU: CM0 r0p0, little endian, no MPU, no FPU, 2 interrupt priority bits
Registers are 32-bit, read-write, reset 0x0 unless marked. A register's access mark holds for its fields unless they carry their own. Offsets are from the block's base; lines under a group give offsets from that group; [hi:lo] are bit positions; {n}, {i} and the like mark numbered series; 'fields as' and 'values as' point back to an identical list; <NAME> marks a mode.

## Memory map
0xE000E010 SysTick size 0x10 — SysTick Timer. Identical register set on every Cortex-M core (ARMv6-M through current ARMv8-M).
0xE000E100 NVIC size 0x320 — Nested Vectored Interrupt Controller. ARMv6-M caps external interrupts at 32 (5-bit encoding), so exactly one ISER/ICER/ISPR/ICPR register and 8 IPR registers cover the whole architectural range -- true for every ARMv6-M device regardless of how many interrupt lines it actually implements (unimplemented lines simply read as 0 / writes ignored). No IABR and no STIR on ARMv6-M (both are ARMv7-M+ only).
0xE000ED00 SCB size 0x40 — System Control Block, ARMv6-M register set. Verified against CMSIS_6 core_cm0.h/core_cm0plus.h defines. No SHPR1, no CFSR/HFSR/MMFAR/BFAR/AFSR (no MemManage/BusFault/UsageFault on v6-M), no AIRCR.PRIGROUP/VECTRESET, no ICSR.RETTOBASE (all ARMv7-M+ only). SHCSR exists but with only one bit (SVCALLPENDED) implemented. VTOR is present in the address map but is only wired up on implementations with __VTOR_PRESENT=1 (e.g. Cortex-M0+); on plain Cortex-M0 that offset is reserved. SHCSR and DFSR are only accessible over the DAP (debugger), not from application code -- see the CoreDebug peripheral's description.
0xE000ED90 MPU size 0x14 — Memory Protection Unit -- OPTIONAL on ARMv6-M: never present on plain Cortex-M0, but commonly implemented on Cortex-M0+ and SC000 (__MPU_PRESENT=1). No alias registers on this profile (verified against CMSIS core_cm0plus.h: MPU_TYPE_RALIASES=1, i.e. RBAR/RASR only).
0xE000EDF0 DCB size 0x10 — Debug Control Block (DHCSR, DCRSR, DCRDR, DEMCR) -- named "CoreDebug" prior to CMSIS_6, which renamed it to DCB across the whole M-profile line ("CoreDebug"/"CoreDebug_Type" remain as deprecated aliases for the same registers). Fixed ADIv5/CoreSight debug architecture -- identical on every Cortex-M core. On ARMv6-M these registers are only accessible over the external Debug Access Port (DAP) by a debugger/probe -- application/firmware code running on the processor cannot read or write them via normal load/store instructions (confirmed in CMSIS core_cm0.h/core_cm0plus.h: "Core Debug Registers ... are only accessible over DAP and not via processor"). On ARMv7-M and later they ARE accessible from firmware. Cortex-M0/M0+'s own headers still don't define this struct at all (DAP-only, "not covered by the header file") -- the register content here is cross-referenced from core_cm4.h/core_cm7.h for documentation purposes.

## Licence text in the file
ARM Limited (ARM) is supplying this software for use with Cortex-M processor based microcontroller, but can be equally used for other suitable processor architectures. This file can be freely distributed. Modifications to this file shall be clearly marked. . THIS SOFTWARE IS PROVIDED "AS IS". NO WARRANTIES, WHETHER EXPRESS, IMPLIED. OR STATUTORY, INCLUDING, BUT NOT LIMITED TO, IMPLIED WARRANTIES OF. MERCHANTABILITY AND FITNESS FOR A PARTICULAR PURPOSE APPLY TO THIS SOFTWARE. ARM SHALL NOT, IN ANY CIRCUMSTANCES, BE LIABLE FOR SPECIAL, INCIDENTAL, OR. CONSEQUENTIAL DAMAGES, FOR ANY REASON WHATSOEVER.
