# Generic_ARMv7M register map
Vendor: ARM Ltd.; Series: ARMv7-M architecture (Cortex-M3 / Cortex-M4 / Cortex-M7 / SC300); File version: 1.0
Generic ARMv7-M system-peripheral template: NVIC (sized to the full architectural 240-interrupt maximum), SCB (with the full fault-handling register set), SCnSCB (ICTR/ACTLR), SysTick, DCB (named CoreDebug prior to CMSIS_6), and an optional MPU. Built from the verified union of what CMSIS_6's core_cm3.h/core_cm4.h/core_cm7.h declare for the architecture (all three are identical at this level -- the FPU-specific register block that exists on Cortex-M4/M7 is deliberately NOT included here, since plain Cortex-M3 has no FPU at all; ask if you want that added separately). Unlike ARMv6-M, DCB and SCB.SHCSR/DFSR are directly accessible from application code on ARMv7-M, not DAP-only. Verified against ARM-software/CMSIS_6@main commit 26206e47dc (2026-09-11), CMSIS-Core(M) v6.3.1-dev.
CPU: CM3 r0p1, little endian, no MPU, no FPU, VTOR, 3 interrupt priority bits
Registers are 32-bit, read-write, reset 0x0 unless marked. A register's access mark holds for its fields unless they carry their own. Offsets are from the block's base; lines under a group give offsets from that group; [hi:lo] are bit positions; {n}, {i} and the like mark numbered series; 'fields as' and 'values as' point back to an identical list; <NAME> marks a mode.

## Memory map
0xE000E000 SCnSCB size 0xC — System Control and ID Registers not in the SCB address range: ICTR (Interrupt Controller Type Register) and ACTLR (Auxiliary Control Register). Verified against CMSIS_6 core_cm3.h/core_cm4.h/core_cm7.h.
0xE000E010 SysTick size 0x10 — SysTick Timer. Identical register set on every Cortex-M core (ARMv6-M through current ARMv8-M).
0xE000E100 NVIC size 0xF04 — Nested Vectored Interrupt Controller. ARMv7-M allows up to 240 external interrupts, so this is sized to the full architectural maximum: 8 banks of ISER/ICER/ISPR/ICPR/IABR and 60 IPR registers. A real device with fewer implemented interrupts still has this whole address range reserved by the architecture -- it just leaves the trailing registers unimplemented (reads as 0). This matches how CMSIS itself models NVIC_Type generically (ISER[8]/ICER[8]/ISPR[8]/ICPR[8]/IABR[8]/IP[240] in core_cm3.h/core_cm4.h) -- your MCU's own vendor SVD/header will only expose as many IRQn as it actually implements.
0xE000ED00 SCB size 0x90 — System Control Block, ARMv7-M register set. Verified against CMSIS_6 core_cm3.h/core_cm4.h/core_cm7.h defines (all three are identical at the SCB level -- the FPU-related extras live in a separate optional FPU block, not shown here, since plain Cortex-M3 has no FPU at all). ID_PFR/ID_DFR/ID_AFR/ID_MMFR/ID_ISAR are read-only ID registers whose exact values are implementation specific (renamed from PFR/DFR/ADR/MMFR/ISAR in CMSIS_6, to match the naming CMSIS has always used for the same registers on ARMv8-M). CMSIS_6's SCB_Type also declares an alias of NVIC's STIR at offset 0x200 (same physical register as NVIC->STIR, at 0xE000EF00) -- not duplicated here, STIR is modeled once, under NVIC, same treatment as SAU/SCB's SFSR/SFAR aliasing on the ARMv8-M Mainline file.
0xE000ED90 MPU size 0x30 — Memory Protection Unit -- OPTIONAL on ARMv7-M (__MPU_PRESENT). When present, includes 3 alias RBAR/RASR pairs so up to 4 regions can be programmed without re-writing RNR each time (verified against CMSIS core_cm3.h/core_cm4.h: MPU_TYPE_RALIASES=4).
0xE000EDF0 DCB size 0x10 — Debug Control Block (DHCSR, DCRSR, DCRDR, DEMCR) -- named "CoreDebug" prior to CMSIS_6, which renamed it to DCB across the whole M-profile line ("CoreDebug"/"CoreDebug_Type" remain as deprecated aliases for the same registers). Fixed ADIv5/CoreSight debug architecture -- identical on every Cortex-M core.

## Licence text in the file
ARM Limited (ARM) is supplying this software for use with Cortex-M processor based microcontroller, but can be equally used for other suitable processor architectures. This file can be freely distributed. Modifications to this file shall be clearly marked. . THIS SOFTWARE IS PROVIDED "AS IS". NO WARRANTIES, WHETHER EXPRESS, IMPLIED. OR STATUTORY, INCLUDING, BUT NOT LIMITED TO, IMPLIED WARRANTIES OF. MERCHANTABILITY AND FITNESS FOR A PARTICULAR PURPOSE APPLY TO THIS SOFTWARE. ARM SHALL NOT, IN ANY CIRCUMSTANCES, BE LIABLE FOR SPECIAL, INCIDENTAL, OR. CONSEQUENTIAL DAMAGES, FOR ANY REASON WHATSOEVER.
